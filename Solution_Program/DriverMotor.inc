# 4
0	M0	C3,R1	42
1	M0	C3,R2	42
2	M0	C3,B1,R2	32
0	M0'	C3,B1,R0	12
1	M0'	C3,R0	42
2	M0'	C3,R1	42
0	2M0	C3,R2	42
1	2M0	C,B0,C2,R2	12
2	2M0	C,B0,C2,R2	52
0	M1	B1,C3,R2	43
1	M1	B0,C,R1	53
2	M1	B1,C,R2	53
0	M1'	B1,C3,R0	43
1	M1'	B2,C3,R1	43
2	M1'	B1,C,R0	53
0	2M1	B1,C3,B0,R2	3
1	2M1	B0,C,R2	53
2	2M1	B1,C,B2,R0	3
0	M2	C,R1	50
1	M2	C,R2	50
2	M2	C,B1,R2	30
0	M2'	C,B1,R0	10
1	M2'	C,R0	50
2	M2'	C,R1	50
0	2M2	C,R2	50
1	2M2	C,B0,R2	30
2	2M2	C,R0	50
0	M3	B1,C,R2	51
1	M3	B2,C,B1,R2	1
2	M3	B1,C3,R2	41
0	M3'	B1,C,R0	51
1	M3'	B2,C,R1	51
2	M3'	B1,C3,R0	41
0	2M3	B1,C,B0,R2	1
1	2M3	B2,C,R0	51
2	2M3	B1,C3,B2,R0	1
0	M4	C2,R1	25
1	M4	C2,R2	25
2	M4	B1,C2,R2	15
0	M4'	B1,C2,R0	35
1	M4'	C2,R0	25
2	M4'	C2,R1	25
0	2M4	C2,R2	25
1	2M4	B2,C2,R0	35
2	2M4	C2,R0	25
0	M5	R1	4
1	M5	R2	4
2	M5	B1,R2	34
0	M5'	B1,R0	14
1	M5'	R0	4
2	M5'	R1	4
0	2M5	R2	4
1	2M5	B2,R0	14
2	2M5	R0	4

# 25
0	M0	C,R1	42
1	M0	C,R2	42
2	M0	C,B1,R2	32
0	M0'	C,B1,R0	12
1	M0'	C,R0	42
2	M0'	C,R1	42
0	2M0	C,R2	42
1	2M0	C,B0,R2	32
2	2M0	C,R0	42
0	M1	B1,C3,R2	53
1	M1	B0,C,R1	43
2	M1	B1,C,R2	43
0	M1'	B1,C3,R0	53
1	M1'	B2,C3,R1	53
2	M1'	B1,C,R0	43
0	2M1	B1,C3,B0,R2	23
1	2M1	B0,C,R2	43
2	2M1	B1,C,B2,R0	23
0	M2	C3,R1	50
1	M2	C3,R2	50
2	M2	C3,B1,R2	30
0	M2'	C3,B1,R0	10
1	M2'	C3,R0	50
2	M2'	C3,R1	50
0	2M2	C3,R2	50
1	2M2	C3,B2,R0	10
2	2M2	C3,R0	50
0	M3	B1,C,R2	41
1	M3	B0,C3,R1	51
2	M3	B1,C3,R2	51
0	M3'	B1,C,R0	41
1	M3'	B2,C,R1	41
2	M3'	B1,C3,R0	51
0	2M3	B1,C,B2,R0	1
1	2M3	B0,C3,R2	51
2	2M3	B1,C3,B0,R2	1
0	M4	R1	25
1	M4	R2	25
2	M4	B1,R2	35
0	M4'	B1,R0	15
1	M4'	R0	25
2	M4'	R1	25
0	2M4	R2	25
1	2M4	B0,R2	35
2	2M4	R0	25
0	M5	C2,R1	4
1	M5	C2,R2	4
2	M5	C2,B1,R2	34
0	M5'	C2,B1,R0	14
1	M5'	C2,R0	4
2	M5'	C2,R1	4
0	2M5	C2,R2	4
1	2M5	C2,B2,R0	14
2	2M5	C2,R0	4

# 42
0	M0	R1	42
1	M0	R2	42
2	M0	B1,R2	32
0	M0'	B1,R0	12
1	M0'	R0	42
2	M0'	R1	42
0	2M0	R2	42
1	2M0	B2,R0	12
2	2M0	R0	42
0	M1	B1,C3,R2	23
1	M1	B0,C,R1	3
2	M1	B1,C,R2	3
0	M1'	B1,C3,R0	23
1	M1'	B0,C,B1,R0	43
2	M1'	B1,C,R0	3
0	2M1	B1,C3,B0,R2	43
1	2M1	B0,C,R2	3
2	2M1	B1,C,B2,R0	43
0	M2	C2,R1	50
1	M2	C2,R2	50
2	M2	C2,B1,R2	30
0	M2'	C2,B1,R0	10
1	M2'	C2,R0	50
2	M2'	C2,R1	50
0	2M2	C2,R2	50
1	2M2	C2,B0,R2	30
2	2M2	C2,R0	50
0	M3	B1,C,R2	1
1	M3	B0,C3,R1	21
2	M3	B1,C3,R2	21
0	M3'	B1,C,R0	1
1	M3'	B2,C,R1	1
2	M3'	B1,C3,R0	21
0	2M3	B1,C,B2,R0	51
1	2M3	B2,C,R0	1
2	2M3	B1,C3,B0,R2	51
0	M4	C3,R1	25
1	M4	C3,R2	25
2	M4	B0,C,R1	5
0	M4'	B2,C,R1	5
1	M4'	C3,R0	25
2	M4'	C3,R1	25
0	2M4	C3,R2	25
1	2M4	C3,B0,R2	35
2	2M4	C3,R0	25
0	M5	C,R1	4
1	M5	C,R2	4
2	M5	C,B1,R2	34
0	M5'	C,B1,R0	14
1	M5'	C,R0	4
2	M5'	C,R1	4
0	2M5	C,R2	4
1	2M5	C,B0,R2	34
2	2M5	C,R0	4

# 43
0	M0	B1,C,R2	12
1	M0	B2,C,B1,R2	42
2	M0	B1,C3,R2	32
0	M0'	B1,C,R0	12
1	M0'	B2,C,R1	12
2	M0'	B1,C3,R0	32
0	2M0	B1,C,B0,R2	42
1	2M0	B2,C,R0	12
2	2M0	B1,C3,B2,R0	42
0	M1	R1	43
1	M1	R2	43
2	M1	B1,R2	3
0	M1'	B1,R0	23
1	M1'	R0	43
2	M1'	R1	43
0	2M1	R2	43
1	2M1	B0,R2	3
2	2M1	R0	43
0	M2	B1,C3,R2	30
1	M2	B0,C,R1	10
2	M2	B1,C,R2	10
0	M2'	B1,C3,R0	30
1	M2'	B0,C,B1,R0	40
2	M2'	B1,C,R0	10
0	2M2	B1,C3,B0,R2	40
1	2M2	B0,C,R2	10
2	2M2	B1,C,B2,R0	40
0	M3	C2,R1	51
1	M3	C2,R2	51
2	M3	C2,B1,R2	1
0	M3'	C2,B1,R0	21
1	M3'	C2,R0	51
2	M3'	C2,R1	51
0	2M3	C2,R2	51
1	2M3	C2,B0,R2	1
2	2M3	C2,R0	51
0	M4	C3,R1	35
1	M4	C3,R2	35
2	M4	B0,C,R1	15
0	M4'	B2,C,R1	15
1	M4'	C3,R0	35
2	M4'	C3,R1	35
0	2M4	C3,R2	35
1	2M4	C3,B2,R0	25
2	2M4	C3,R0	35
0	M5	C,R1	14
1	M5	C,R2	14
2	M5	C,B1,R2	4
0	M5'	C,B1,R0	24
1	M5'	C,R0	14
2	M5'	C,R1	14
0	2M5	C,R2	14
1	2M5	C,B0,R2	4
2	2M5	C,R0	14

# 50
0	M0	C2,R1	42
1	M0	C2,R2	42
2	M0	C2,B1,R2	32
0	M0'	C2,B1,R0	12
1	M0'	C2,R0	42
2	M0'	C2,R1	42
0	2M0	C2,R2	42
1	2M0	C2,B0,R2	32
2	2M0	C2,R0	42
0	M1	B1,C3,R2	3
1	M1	B0,C,R1	23
2	M1	B1,C,R2	23
0	M1'	B1,C3,R0	3
1	M1'	B0,C,B1,R0	53
2	M1'	B1,C,R0	23
0	2M1	B1,C3,B2,R0	43
1	2M1	B0,C,R2	23
2	2M1	B1,C,B0,R2	43
0	M2	R1	50
1	M2	R2	50
2	M2	B1,R2	30
0	M2'	B1,R0	10
1	M2'	R0	50
2	M2'	R1	50
0	2M2	R2	50
1	2M2	B0,R2	30
2	2M2	R2	50
0	M3	B1,C,R2	21
1	M3	B2,C,B1,R2	51
2	M3	B1,C3,R2	1
0	M3'	B1,C,R0	21
1	M3'	B2,C,R1	21
2	M3'	B1,C3,R0	1
0	2M3	B1,C,B0,R2	51
1	2M3	B2,C,R0	21
2	2M3	B1,C3,B2,R0	51
0	M4	C,R1	25
1	M4	C,R2	25
2	M4	C,B1,R2	35
0	M4'	C,B1,R0	15
1	M4'	C,R0	25
2	M4'	C,R1	25
0	2M4	C,R2	25
1	2M4	C,B0,R2	35
2	2M4	C,R0	25
0	M5	C3,R1	4
1	M5	C3,R2	4
2	M5	B0,C,R1	24
0	M5'	B2,C,R1	24
1	M5'	C3,R0	4
2	M5'	C3,R1	4
0	2M5	C3,R2	4
1	2M5	C3,B0,R2	34
2	2M5	C3,R0	4

# 51
0	M0	B1,C,R2	32
1	M0	B0,C3,R1	12
2	M0	B1,C3,R2	12
0	M0'	B1,C,R0	32
1	M0'	B2,C,R1	32
2	M0'	B1,C3,R0	12
0	2M0	B1,C,B2,R0	42
1	2M0	B2,C,R0	32
2	2M0	B1,C3,B0,R2	42
0	M1	C2,R1	43
1	M1	C2,R2	43
2	M1	C2,B1,R2	3
0	M1'	C2,B1,R0	23
1	M1'	C2,R0	43
2	M1'	C2,R1	43
0	2M1	C2,R2	43
1	2M1	C2,B0,R2	3
2	2M1	C2,R0	43
0	M2	B1,C3,R2	10
1	M2	B0,C,R1	30
2	M2	B1,C,R2	30
0	M2'	B1,C3,R0	10
1	M2'	B2,C3,R1	10
2	M2'	B1,C,R0	30
0	2M2	B1,C3,B0,R2	50
1	2M2	B0,C,R2	30
2	2M2	B1,C,B2,R0	50
0	M3	R1	51
1	M3	R2	51
2	M3	B1,R2	1
0	M3'	B1,R0	21
1	M3'	R0	51
2	M3'	R1	51
0	2M3	R2	51
1	2M3	B2,R0	21
2	2M3	R0	51
0	M4	C,R1	35
1	M4	C,R2	35
2	M4	C,B1,R2	5
0	M4'	C,B1,R0	25
1	M4'	C,R0	35
2	M4'	C,R1	35
0	2M4	C,R2	35
1	2M4	C,B2,R0	25
2	2M4	C,R0	35
0	M5	C3,R1	14
1	M5	C3,R2	14
2	M5	B0,C,R1	34
0	M5'	B2,C,R1	34
1	M5'	C3,R0	14
2	M5'	C3,R1	14
0	2M5	C3,R2	14
1	2M5	C3,B0,R2	4
2	2M5	C3,R0	14

# 52
0	M0	R1	52
1	M0	R2	52
2	M0	B1,R2	12
0	M0'	B1,R0	32
1	M0'	R0	52
2	M0'	R1	52
0	2M0	R2	52
1	2M0	B0,R2	12
2	2M0	R0	52
0	M1	B1,C,R2	3
1	M1	B0,C3,R1	23
2	M1	B1,C3,R2	23
0	M1'	B1,C,R0	3
1	M1'	B2,C,R1	3
2	M1'	B1,C3,R2	23
0	2M1	B1,C,B0,R2	53
1	2M1	B2,C,R0	3
2	2M1	B1,C3,B2,R0	53
0	M2	C2,R1	40
1	M2	C2,R2	40
2	M2	C2,B1,R2	10
0	M2'	C2,B1,R0	30
1	M2'	C2,R0	40
2	M2'	C2,R1	40
0	2M2	C2,R2	40
1	2M2	C2,B0,R2	10
2	2M2	C2,R0	40
0	M3	B1,C3,R2	21
1	M3	B0,C,R1	1
2	M3	B1,C,R2	1
0	M3'	B1,C3,R0	21
1	M3'	B2,C3,R1	21
2	M3'	B1,C,R0	1
0	2M3	B1,C3,B0,R2	51
1	2M3	B0,C,R2	1
2	2M3	B1,C,B2,R0	51
0	M4	C,R1	5
1	M4	C,R2	5
2	M4	C,B1,R2	15
0	M4'	C,B1,R0	35
1	M4'	C,R0	5
2	M4'	C,R1	5
0	2M4	C,R2	5
1	2M4	C,B0,R2	15
2	2M4	C,R0	5
0	M5	C3,R1	24
1	M5	C3,R2	24
2	M5	C3,B1,R2	14
0	M5'	C3,B1,R0	34
1	M5'	C3,R0	24
2	M5'	C3,R1	24
0	2M5	C3,R2	24
1	2M5	C3,B0,R2	14
2	2M5	C3,R0	24

# 53
0	M0	B1,C3,R2	32
1	M0	B0,C,R1	12
2	M0	B1,C,R2	12
0	M0'	B1,C3,R0	32
1	M0'	B2,C3,R1	32
2	M0'	B1,C,R0	12
0	2M0	B1,C3,B0,R2	52
1	2M0	B0,C,R2	12
2	2M0	B1,C,B2,R0	52
0	M1	R1	53
1	M1	R2	53
2	M1	B1,R2	23
0	M1'	B1,R0	3
1	M1'	R0	53
2	M1'	R1	53
0	2M1	R2	53
1	2M1	B0,R2	23
2	2M1	R0	53
0	M2	B1,C,R2	10
1	M2	B0,C3,R1	30
2	M2	B1,C3,R2	30
0	M2'	B1,C,R0	10
1	M2'	B2,C,R1	10
2	M2'	B1,C3,R0	30
0	2M2	B1,C,B0,R2	50
1	2M2	B2,C,R0	10
2	2M2	B1,C3,B2,R0	50
0	M3	C2,R1	41
1	M3	C2,R2	41
2	M3	C2,B1,R2	21
0	M3'	C2,B1,R0	1
1	M3'	C2,R0	41
2	M3'	C2,R1	41
0	2M3	C2,R2	41
1	2M3	C2,B0,R2	21
2	2M3	C2,R0	41
0	M4	C,R1	15
1	M4	C,R2	15
2	M4	C,B1,R2	25
0	M4'	C,B1,R0	5
1	M4'	C,R0	15
2	M4'	C,R1	15
0	2M4	C,R2	15
1	2M4	C,B0,R2	25
2	2M4	C,R0	15
0	M5	C3,R1	34
1	M5	C3,R2	34
2	M5	C3,B1,R2	24
0	M5'	C3,B1,R0	4
1	M5'	C3,R0	34
2	M5'	C3,R1	34
0	2M5	C3,R2	34
1	2M5	C3,B2,R0	4
2	2M5	C3,R0	34

# 12			
0	SETUP	C,B1	51
1	SETUP	B0	42
2	SETUP	B1	42
			
# 32			
0	SETUP	B1	42
1	SETUP	B2	42
2	SETUP	B0,C,B1	51

# 3			
0	SETUP	B1	43
1	SETUP	B2	43
2	SETUP	C,B1	50
			
# 23			
0	SETUP	C3,B1	50
1	SETUP	B0	43
2	SETUP	B1	43
			
# 10			
0	SETUP	C3,B1	43
1	SETUP	B0	50
2	SETUP	B1	50
			
# 30			
0	SETUP	B1	50
1	SETUP	B2	50
2	SETUP	C,B1	43
			
# 40			
0	SETUP	B2	50
1	SETUP	B2,C,B1	43
2	SETUP	B0	50

# 1			
0	SETUP	B1	51
1	SETUP	B2	51
2	SETUP	C3,B1	42
			
# 21			
0	SETUP	C,B1	42
1	SETUP	B0	51
2	SETUP	B1	51
			
# 41			
0	SETUP	B2	51
1	SETUP	B0,C,B1	42
2	SETUP	B0	51

# 5			
0	SETUP	B2	25
1	SETUP	B0,C2,B1	4
2	SETUP	B0	25
			
# 15			
0	SETUP	C,B2	51
1	SETUP	B0	25
2	SETUP	B1	25
			
# 35			
0	SETUP	B1	25
1	SETUP	B2	25
2	SETUP	C	43

# 14			
0	SETUP	C	51
1	SETUP	B0	4
2	SETUP	B1	4
			
# 24			
0	SETUP	B2	4
1	SETUP	B2,C2,B1	25
2	SETUP	B0	4
			
# 34			
0	SETUP	B1	4
1	SETUP	B2	4
2	SETUP	C2,B1	25
